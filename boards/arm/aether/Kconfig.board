## boards/arm/aether/Kconfig.board
```kconfig
# Aether board

config BOARD_AETHER
	bool "Aether Air Quality Sensor Board"
	depends on SOC_STM32WLE5XX
```

## boards/arm/aether/Kconfig.defconfig
```kconfig
# Aether board configuration

if BOARD_AETHER

config BOARD
	default "aether_board"

endif # BOARD_AETHER
```

## drivers/sensor/Kconfig
```kconfig
rsource "zmod4510/Kconfig"
rsource "sps30/Kconfig"

config CUSTOM_SENSOR_SHELL
  bool "Enable the custom sensor shell"
  depends on SHELL
  select CBPRINTF_FP_SUPPORT
  default y if !SHELL_MINIMAL
  help
    This shell provides access to extended sensor data.
```

## drivers/sensor/sps30/Kconfig
```kconfig
config SPS30
	bool "SPS30 Particulate Matter Sensor"
	depends on I2C
	help
	  Enable driver for SPS30 particulate matter sensor
```

## drivers/sensor/zmod4510/Kconfig
```kconfig
config ZMOD4510
	bool "Enabled ZMOD4510 air quality sensor"
	depends on I2C
	help
	  Enable driver for ZMOD4510 air quality sensor

config ZMOD4510_HUMIDITY
  bool "Enable ZMOD4510 humidity compensation"
  depends on ZMOD4510
  default n
  help 
    Enable support for humidity compensation. humidity-sensor must be added to DTS.

config ZMOD4510_TEMPERATURE
  bool "Enable ZMOD4510 temperature compensation"
  depends on ZMOD4510
  default n
  help 
    Enable support for temperature compensation. temperature-sensor must be added to DTS.
```
