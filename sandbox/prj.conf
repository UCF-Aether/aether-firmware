## prj.conf
```kconfig
# General
CONFIG_MAIN_STACK_SIZE=2048
CONFIG_SYSTEM_WORKQUEUE_STACK_SIZE=2048
CONFIG_NEWLIB_LIBC=y
CONFIG_NEWLIB_LIBC_FLOAT_PRINTF=y
CONFIG_CBPRINTF_FP_SUPPORT=y

# IO
CONFIG_I2C=y
CONFIG_SPI=y
CONFIG_GPIO=y
CONFIG_UART_ASYNC_API=y

# Logging
CONFIG_STDOUT_CONSOLE=y
CONFIG_LOG=y
CONFIG_ARCH_LOG_LEVEL_DBG=y
CONFIG_KERNEL_LOG_LEVEL_DBG=n
CONFIG_SENSOR_LOG_LEVEL_DBG=n

# Lora
CONFIG_LORA=y
CONFIG_LORA_SX12XX=y
CONFIG_LORAWAN=y
CONFIG_LORAMAC_REGION_US915=y

# Sensors
CONFIG_SENSOR=n
CONFIG_SPS30=y
CONFIG_BME680=y
CONFIG_ZMOD4510=y

# Power Management
CONFIG_PM=y
CONFIG_PM_DEVICE=y
CONFIG_PM_DEVICE_POWER_DOMAIN=y

# Shell
CONFIG_PRINTK=y
CONFIG_SHELL=y
CONFIG_INIT_STACKS=y
CONFIG_THREAD_STACK_INFO=y
CONFIG_KERNEL_SHELL=y
CONFIG_THREAD_MONITOR=y
CONFIG_BOOT_BANNER=n
CONFIG_THREAD_NAME=y
CONFIG_DEVICE_SHELL=y
CONFIG_POSIX_CLOCK=y
CONFIG_DATE_SHELL=y
CONFIG_THREAD_RUNTIME_STATS=y
CONFIG_THREAD_RUNTIME_STATS_USE_TIMING_FUNCTIONS=y
CONFIG_STATS=y
CONFIG_STATS_SHELL=y
CONFIG_SENSOR_SHELL=n
CONFIG_CUSTOM_SENSOR_SHELL=y

CONFIG_THREAD_NAME=y
CONFIG_SEGGER_SYSTEMVIEW=y
CONFIG_USE_SEGGER_RTT=y
CONFIG_TRACING=y
# enable for post-mortem tracing
CONFIG_SEGGER_SYSVIEW_POST_MORTEM_MODE=y
```

## src/main.c
```c
/*
 * Sandbox application to experiment with Zephyr and Aether features.
 *
 */

#include <zephyr.h>
#include <device.h>
#include <drivers/gpio.h>
#include <logging/log.h>
#include <stdio.h>
#include <stdlib.h>
#include <stdint.h>

LOG_MODULE_REGISTER(sandbox);

static struct gpio_dt_spec usb_detect = GPIO_DT_SPEC_GET(DT_NODELABEL(usb_wakeup), gpios);
static struct gpio_dt_spec led = GPIO_DT_SPEC_GET(DT_ALIAS(led0), gpios);
static struct gpio_callback usb_detect_cb_data;

void usb_handler(const struct device *dev, struct gpio_callback *cb, uint32_t pins) {
  if (gpio_pin_get_dt(&usb_detect)) {
    printk("usb inserted\n");
    gpio_pin_set_dt(&led, 1);
  }
  else {
    printk("usb removed\n");
    gpio_pin_set_dt(&led, 0);
  }
}

void main() {
  int ret;

  ret = gpio_pin_configure_dt(&led, GPIO_OUTPUT_ACTIVE);
  if (ret) {
    printk("Error %d: failed to configure pin %d\n", ret, usb_detect.pin);
    return;
  }

  if (!pm_device_wakeup_enable((struct device *) usb_detect.port, true)) {
    printk("Error: failed to enabled wakeup on %s pin %d\n",
        usb_detect.port->name,
        usb_detect.pin);
    return;
  }

  ret = gpio_pin_configure_dt(&usb_detect, GPIO_INPUT);
  if (ret) {
    printk("Error %d: failed to configure pin %d\n", ret, usb_detect.pin);
    return;
  }

  ret = gpio_pin_interrupt_configure_dt(&usb_detect, GPIO_INT_EDGE_BOTH);
  if (ret) {
    printk("Error %d: failed to configure interupt on %s pin %d\n", 
        ret, 
        usb_detect.port->name, 
        usb_detect.pin);
    return;
  }

  gpio_init_callback(&usb_detect_cb_data, usb_handler, BIT(usb_detect.pin));
  gpio_add_callback(usb_detect.port, &usb_detect_cb_data);
  printk("Set up usb detect at %s pin %d\n", usb_detect.port->name, usb_detect.pin);

  while (1) {
    LOG_INF("testing");
    k_msleep(500);
  }
}
```
